## boards/shields/mosfkp/Kconfig.defconfig
```kconfig
if SHIELD_MOSFKP_LEFT

config ZMK_SPLIT
    default y

endif

if SHIELD_MOSFKP_RIGHT

config ZMK_SPLIT
    default y

endif
```

## boards/shields/mosfkp/Kconfig.shield
```kconfig
config SHIELD_MOSFKP_LEFT
    def_bool $(shields_list_contains,mosfkp_left)

config SHIELD_MOSFKP_RIGHT
    def_bool $(shields_list_contains,mosfkp_right)
```
